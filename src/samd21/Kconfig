## src/samd21/Kconfig
```kconfig
# Kconfig settings for SAMD21 processors

if MACH_SAMD21

config SAMD_SELECT
    bool
    default y
    select HAVE_GPIO

config BOARD_DIRECTORY
    string
    default "samd21"

config CLOCK_FREQ
    int
    default 48000000

config SERIAL
    bool
    default y
config SERIAL_BAUD
    depends on SERIAL
    int "Baud rate for serial port"
    default 250000

endif
```
